## boards/shields/eyelash_keyball/Kconfig.shield
```kconfig
config SHIELD_EYELASHKEYBALL_LEFT
    def_bool $(shields_list_contains,eyelashkeyball_left)

config SHIELD_EYELASHKEYBALL_RIGHT
    def_bool $(shields_list_contains,eyelashkeyball_right)
```

## boards/shields/offsetkey/Kconfig.defconfig
```kconfig
if SHIELD_OFFSETKEY_CENTRAL_DONGLE

config ZMK_KEYBOARD_NAME
	default "offsetkey"

config ZMK_SPLIT_BLE_ROLE_CENTRAL
	default y

endif # Keyboard with dongle


if SHIELD_OFFSETKEY_PERIPHERAL_RIGHT && ! DONGLE_MODE

config ZMK_KEYBOARD_NAME
	default "offsetkey"

config ZMK_SPLIT_BLE_ROLE_CENTRAL
	default y

endif # Keyboard without dongle


if SHIELD_OFFSETKEY_CENTRAL_DONGLE || SHIELD_OFFSETKEY_PERIPHERAL_LEFT || SHIELD_OFFSETKEY_PERIPHERAL_RIGHT

config ZMK_SPLIT
	default y
	
endif


if ZMK_DISPLAY

config I2C
    default y

config SSD1306
    default y

choice ZMK_DISPLAY_WORK_QUEUE
    default ZMK_DISPLAY_WORK_QUEUE_DEDICATED
endchoice

endif

if LVGL

config LV_Z_VDB_SIZE
    default 64

config LV_DPI_DEF
    default 148

config LV_Z_BITS_PER_PIXEL
    default 1

choice LV_COLOR_DEPTH
    default LV_COLOR_DEPTH_1
endchoice

endif # LVGL



if ZMK_BACKLIGHT

config PWM
    default y

config LED_PWM
    default y

endif # ZMK_BACKLIGHT



config BOARD_ENABLE_DCDC
    bool "Enable DCDC mode"
    select SOC_DCDC_NRF52X
    default y
    depends on (SHIELD_OFFSETKEY_LEFT || SHIELD_OFFSETKEY_RIGHT)

config BOARD_ENABLE_DCDC_HV
    bool "Enable High Voltage DCDC converter"
    default y
    select SOC_DCDC_NRF52X_HV
    depends on (SHIELD_OFFSETKEY_LEFT || SHIELD_OFFSETKEY_RIGHT)
```

## boards/shields/offsetkey/Kconfig.shield
```kconfig
config SHIELD_OFFSETKEY_CENTRAL_DONGLE
    def_bool $(shields_list_contains,offsetkey_central_dongle)

config SHIELD_OFFSETKEY_PERIPHERAL_LEFT
    def_bool $(shields_list_contains,offsetkey_peripheral_left)

config SHIELD_OFFSETKEY_PERIPHERAL_RIGHT
    def_bool $(shields_list_contains,offsetkey_peripheral_right)
```
